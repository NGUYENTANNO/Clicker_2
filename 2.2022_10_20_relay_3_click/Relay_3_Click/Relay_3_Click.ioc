# file: Relay_3_Click.ioc
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Mcu.Family=STM32F4
Mcu.Name=STM32F407V(E-G)Tx
Mcu.Package=LQFP100
NVIC.PriorityGroup=NVIC_PRIORITYGROUP_4
PA13.Mode=Serial_Wire
PA13.Signal=SYS_JTMS-SWDIO
PA14.Mode=Serial_Wire
PA14.Signal=SYS_JTCK-SWCLK
PH0-OSC_IN.Mode=HSE-External-Oscillator
PH0-OSC_IN.Signal=RCC_OSC_IN
PH1-OSC_OUT.Mode=HSE-External-Oscillator
PH1-OSC_OUT.Signal=RCC_OSC_OUT
ProjectManager.HeapSize=0x200
ProjectManager.StackSize=0x400
ProjectManager.TargetToolchain=MDK-ARM V5.32
RCC.48MHZClocksFreq_Value=84000000
RCC.AHBFreq_Value=168000000
RCC.APB1CLKDivider=RCC_HCLK_DIV4
RCC.APB1Freq_Value=42000000
RCC.APB1TimFreq_Value=84000000
RCC.APB2CLKDivider=RCC_HCLK_DIV2
RCC.APB2Freq_Value=84000000
RCC.APB2TimFreq_Value=168000000
RCC.CortexFreq_Value=168000000
RCC.HCLKFreq_Value=168000000
RCC.HSE_VALUE=25000000
RCC.HSI_VALUE=16000000
RCC.LSE_VALUE=32768
RCC.PLLM=25
RCC.PLLN=336
RCC.PLLSourceVirtual=RCC_PLLSOURCE_HSE
RCC.SYSCLKFreq_VALUE=168000000
RCC.SYSCLKSource=RCC_SYSCLKSOURCE_PLLCLK
RCC.VCOOutputFreq_Value=336000000
board=custom

// file: Core/Src/main.c
/* USER CODE BEGIN Header */
/**
  ******************************************************************************
  * @file           : main.c
  * @brief          : Main program body
  ******************************************************************************
  * @attention
  *
  * Copyright (c) 2022 STMicroelectronics.
  * All rights reserved.
  *
  * This software is licensed under terms that can be found in the LICENSE file
  * in the root directory of this software component.
  * If no LICENSE file comes with this software, it is provided AS-IS.
  *
  ******************************************************************************
  */
/* USER CODE END Header */
#include "main.h"
#include "math.h"

void SystemClock_Config(void);
static void MX_GPIO_Init(void);

/* USER CODE BEGIN 0 */
void bitWrite(GPIO_TypeDef* GPIOx, uint16_t GPIO_Pin, GPIO_PinState PinState)
{
	if(PinState == 1)
		GPIOx->BSRR= (uint32_t)pow(2,GPIO_Pin);
	else
		GPIOx->BSRR = (uint32_t)pow(2,GPIO_Pin)<<16U;
}
/* USER CODE END 0 */

int main(void)
{

  /* MCU Configuration--------------------------------------------------------*/

  /* Reset of all peripherals, Initializes the Flash interface and the Systick. */
  HAL_Init();

  /* Configure the system clock */
  SystemClock_Config();

  /* Initialize all configured peripherals */
  MX_GPIO_Init();
  /* USER CODE BEGIN 2 */
	/***********Enable clock PORTE, PORTA**********
	***********************************************
	***********************************************/
	RCC->AHB1ENR =  (1<<4);  	  //GPIOE clock enable
	RCC->AHB1ENR |= (1<<0);  		//GPIOA clock enable
	/***********EGPIO Config for ******************
	******PE0, 	PA10		: input pull-up for button***
	******PE12, PE15 		: Output for led*************
	******PE7, 	PA12		: Output for control 2 relay*
	*************************************************/
	//////////////////////INPUT//////////////////////////////
	GPIOE->MODER |= (0<<0);  	// pin PE0(bits 1:0 as intput (00))
	GPIOA->MODER |= (0<<20); 	// pin PA10(bits 21:20 as intput (00))
	GPIOE->PUPDR |= (1<<0);		// pin PE0(bits 1:0 as pull-up (01))
	GPIOA->PUPDR |= (1<<20);	// pin PA10(bits 21:20 as pull-up (01))
	////////////////////////OUTPUT///////////////////////////
	GPIOE->MODER |= (1<<24);  // pin PE12(bits 25:24) is Output (01)
	GPIOE->MODER |= (1<<30); 	// pin PE15(bits 31:30) is Output (01)
	////////////////////////OUTPUT//////////////////////////
	GPIOE->MODER |=  (1<<14);  // pin PE7(bits 18:17) is Output (01)
	GPIOE->MODER |= (1<<16); 	// pin PE8(bits 17:16) is Output (01)
  /* USER CODE END 2 */
  /* Infinite loop */
  /* USER CODE BEGIN WHILE */
  while (1)
  {

	//bitWrite(GPIOE,12,0);
		HAL_GPIO_WritePin(GPIOE,GPIO_PIN_12,0);
		HAL_GPIO_WritePin(GPIOE,1<<15,1);
		HAL_GPIO_WritePin(GPIOE,1<<7,1);
		HAL_GPIO_WritePin(GPIOE,1<<8,0);
		if(HAL_GPIO_ReadPin(GPIOA,1<<10)==0)
		 HAL_Delay(100);
		else if (HAL_GPIO_ReadPin(GPIOE,1<<0)==0)
			HAL_Delay(500);
		else
			HAL_Delay(1000);
	//bitWrite(GPIOE,12,1);
		HAL_GPIO_WritePin(GPIOE,GPIO_PIN_12,1);
		HAL_GPIO_WritePin(GPIOE,1<<15,0);
		HAL_GPIO_WritePin(GPIOE,1<<7,0);
		HAL_GPIO_WritePin(GPIOE,1<<8,1);
		if(HAL_GPIO_ReadPin(GPIOA,1<<10)==0)
		 HAL_Delay(100);
		else if (HAL_GPIO_ReadPin(GPIOE,1<<0)==0)
			HAL_Delay(500);
		else
			HAL_Delay(1000);

		//	HAL_GPIO_WritePin(
    /* USER CODE END WHILE */

  }
}

void SystemClock_Config(void)
{
  RCC_OscInitTypeDef RCC_OscInitStruct = {0};
  RCC_ClkInitTypeDef RCC_ClkInitStruct = {0};

  /** Configure the main internal regulator output voltage
  */
  __HAL_RCC_PWR_CLK_ENABLE();
  __HAL_PWR_VOLTAGESCALING_CONFIG(PWR_REGULATOR_VOLTAGE_SCALE1);

  /** Initializes the RCC Oscillators according to the specified parameters
  * in the RCC_OscInitTypeDef structure.
  */
  RCC_OscInitStruct.OscillatorType = RCC_OSCILLATORTYPE_HSE;
  RCC_OscInitStruct.HSEState = RCC_HSE_ON;
  RCC_OscInitStruct.PLL.PLLState = RCC_PLL_ON;
  RCC_OscInitStruct.PLL.PLLSource = RCC_PLLSOURCE_HSE;
  RCC_OscInitStruct.PLL.PLLM = 25;
  RCC_OscInitStruct.PLL.PLLN = 336;
  RCC_OscInitStruct.PLL.PLLP = RCC_PLLP_DIV2;
  RCC_OscInitStruct.PLL.PLLQ = 4;
  if (HAL_RCC_OscConfig(&RCC_OscInitStruct) != HAL_OK)
  {
    Error_Handler();
  }

  /** Initializes the CPU, AHB and APB buses clocks
  */
  RCC_ClkInitStruct.ClockType = RCC_CLOCKTYPE_HCLK|RCC_CLOCKTYPE_SYSCLK
                              |RCC_CLOCKTYPE_PCLK1|RCC_CLOCKTYPE_PCLK2;
  RCC_ClkInitStruct.SYSCLKSource = RCC_SYSCLKSOURCE_PLLCLK;
  RCC_ClkInitStruct.AHBCLKDivider = RCC_SYSCLK_DIV1;
  RCC_ClkInitStruct.APB1CLKDivider = RCC_HCLK_DIV4;
  RCC_ClkInitStruct.APB2CLKDivider = RCC_HCLK_DIV2;

  if (HAL_RCC_ClockConfig(&RCC_ClkInitStruct, FLASH_LATENCY_5) != HAL_OK)
  {
    Error_Handler();
  }
}

static void MX_GPIO_Init(void)
{

  /* GPIO Ports Clock Enable */
  __HAL_RCC_GPIOH_CLK_ENABLE();
  __HAL_RCC_GPIOA_CLK_ENABLE();

}

void Error_Handler(void)
{
  __disable_irq();
  while (1)
  {
  }
}
